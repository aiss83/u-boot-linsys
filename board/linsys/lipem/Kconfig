## board/linsys/lipem/Kconfig
```kconfig
if TARGET_LIPEM

config SYS_BOARD
	default "lipem"

config SYS_VENDOR
	default "linsys"

config SYS_SOC
	default "am33xx"

config SYS_CONFIG_NAME
	default "linsys_lipem"

endif
```

## configs/linsys_lipem_defconfig
```kconfig
CONFIG_ARM=y
CONFIG_ARCH_CPU_INIT=y
CONFIG_ARCH_OMAP2PLUS=y
# CONFIG_TI_COMMON_CMD_OPTIONS=y
CONFIG_AM33XX=y
CONFIG_TARGET_LIPEM=y
CONFIG_SYS_MPUCLK=600
CONFIG_SPL=y
CONFIG_BOOTCOMMAND=""
CONFIG_VERSION_VARIABLE=y
CONFIG_ARCH_MISC_INIT=y
CONFIG_SPL_OS_BOOT=y
CONFIG_SPL_LEGACY_IMAGE_SUPPORT=n
CONFIG_CMD_SPL=y
CONFIG_CMD_SPL_NAND_OFS=0x00080000
# CONFIG_CMD_FLASH is not set
CONFIG_CMD_NAND=y
# CONFIG_CMD_SETEXPR is not set
CONFIG_CMD_MTDPARTS=y
CONFIG_MTDIDS_DEFAULT="nand0=nand.0"
CONFIG_MTDPARTS_DEFAULT="mtdparts=nand.0:128k(NAND.SPL),128k(NAND.SPL.backup1),128k(NAND.SPL.backup2),128k(NAND.SPL.backup3),256k(NAND.u-boot-spl-os),1m(NAND.u-boot),128k(NAND.u-boot-env),128k(NAND.u-boot-env.backup1),8m(NAND.kernel),-(NAND.file-system)"
CONFIG_OF_CONTROL=y
CONFIG_DEFAULT_DEVICE_TREE="linsys-lipem"
CONFIG_OF_LIST="linsys-lipem"
CONFIG_SYS_RELOC_GD_ENV_ADDR=y
CONFIG_ENV_VARS_UBOOT_RUNTIME_CONFIG=n
CONFIG_SPL_ENV_IS_NOWHERE=y
CONFIG_BOOTCOUNT_LIMIT=y
CONFIG_CLK=n
CONFIG_DFU_NAND=y
CONFIG_DFU_RAM=y
CONFIG_DM_I2C=n
CONFIG_MISC=y
CONFIG_MTD=y
CONFIG_MTD_RAW_NAND=y
CONFIG_DM_SPI_FLASH=y
CONFIG_SF_DEFAULT_SPEED=24000000
CONFIG_SPI_FLASH_WINBOND=y
CONFIG_DM_ETH=n
CONFIG_MII=n
CONFIG_SPI=y
CONFIG_DM_SPI=y
CONFIG_OMAP3_SPI=y
CONFIG_TIMER=y
CONFIG_OMAP_TIMER=y
CONFIG_WDT=y
# CONFIG_SPL_WDT is not set
CONFIG_DYNAMIC_CRC_TABLE=y
CONFIG_LZO=y
# CONFIG_OF_LIBFDT_OVERLAY is not set
CONFIG_BOOTM_PLAN9=n
CONFIG_BOOTM_RTEMS=n
CONFIG_BOOTM_VXWORKS=n
CONFIG_CMD_BOOTEFI=n
CONFIG_CMD_BOOTEFI_HELLO_COMPILE=n
CONFIG_BOOTM_NETBSD=n
CONFIG_BOOTM_EFI=n
CONFIG_CMD_ELF=n
CONFIG_SYS_MMCSD_RAW_MODE_U_BOOT_USE_SECTOR=n
CONFIG_CMD_LOADS=n
CONFIG_CMD_NFS=n
CONFIG_PARTITIONS=n
CONFIG_HAVE_BLOCK_DEVICE=n
CONFIG_MMC=n
CONFIG_GENERATE_SMBIOS_TABLE=n
CONFIG_EFI_LOADER=n
```
